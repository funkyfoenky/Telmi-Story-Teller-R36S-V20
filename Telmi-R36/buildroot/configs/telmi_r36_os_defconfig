## Telmi-R36/buildroot/configs/telmi_r36_os_defconfig
```kconfig
BR2_aarch64=y
BR2_cortex_a35=y
BR2_TOOLCHAIN_EXTERNAL=y
BR2_TOOLCHAIN_EXTERNAL_BOOTLIN=y
BR2_TOOLCHAIN_EXTERNAL_BOOTLIN_AARCH64_GLIBC_STABLE=y
BR2_TARGET_GENERIC_HOSTNAME="TelmiR36"
BR2_ROOTFS_DEVICE_CREATION_DYNAMIC_EUDEV=y
BR2_TARGET_GENERIC_ROOT_PASSWD="root"
BR2_ROOTFS_OVERLAY="board/telmi-r36/overlay"
BR2_PACKAGE_DEJAVU=y
BR2_PACKAGE_LIBPNG=y
BR2_PACKAGE_JPEG=y
BR2_PACKAGE_FREETYPE=y
BR2_PACKAGE_LIBMAD=y
BR2_PACKAGE_ALSA_LIB=y
BR2_PACKAGE_ALSA_UTILS=y
BR2_PACKAGE_ALSA_UTILS_AMIXER=y
BR2_PACKAGE_ALSA_UTILS_APLAY=y
BR2_PACKAGE_MESA3D=y
BR2_PACKAGE_MESA3D_GALLIUM_DRIVER_PANFROST=y
BR2_PACKAGE_MESA3D_GALLIUM_DRIVER_SWRAST=y
BR2_PACKAGE_MESA3D_OPENGL_EGL=y
BR2_PACKAGE_MESA3D_OPENGL_ES=y
BR2_PACKAGE_SDL2=y
BR2_PACKAGE_SDL2_KMSDRM=y
BR2_PACKAGE_SDL2_OPENGLES=y
BR2_PACKAGE_SDL2_IMAGE=y
BR2_PACKAGE_SDL2_TTF=y
BR2_PACKAGE_SDL2_MIXER=y
BR2_PACKAGE_SDL2_GFX=y
BR2_PACKAGE_TELMI_R36S=y
BR2_TARGET_ROOTFS_EXT2=y
BR2_TARGET_ROOTFS_EXT2_4=y
BR2_TARGET_ROOTFS_EXT2_SIZE="768M"
BR2_TARGET_ROOTFS_TAR=y
```

## Telmi-R36/external/telmi-r36/package/telmi-r36s/Config.in
```kconfig
config BR2_PACKAGE_TELMI_R36S
	bool "telmi-r36s"
	depends on BR2_PACKAGE_SDL2
	depends on BR2_PACKAGE_SDL2_IMAGE
	depends on BR2_PACKAGE_SDL2_TTF
	depends on BR2_PACKAGE_SDL2_MIXER
	help
	  TelmiOS story teller pour R36S.
```
